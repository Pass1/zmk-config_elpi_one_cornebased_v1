## config/boards/shields/Kconfig.defconfig
```kconfig
if SHIELD_ELPI_ONE_LEFT

# Name must be less than 16 characters long!
config ZMK_KEYBOARD_NAME
    default "Elpi One"

config ZMK_SPLIT_ROLE_CENTRAL
    default y

endif

if SHIELD_ELPI_ONE_LEFT || SHIELD_ELPI_ONE_RIGHT

config ZMK_SPLIT
    default y

endif
```

## config/boards/shields/elpi_one/Kconfig.shield
```kconfig
# No whitespace after the comma or in your keyboard name!
config SHIELD_ELPI_ONE_LEFT
    def_bool $(shields_list_contains,elpi_one_left)

config SHIELD_ELPI_ONE_RIGHT
    def_bool $(shields_list_contains,elpi_one_right)
```
